## t-dongle-s3/sdkconfig.defaults
```kconfig
# T-Dongle-S3 — USB-to-WiFi bridge for AA/CarPlay
# Target: ESP32-S3 (LilyGO T-Dongle-S3)

# CPU & Memory
CONFIG_ESP_DEFAULT_CPU_FREQ_240=y
CONFIG_SPIRAM=n

# Flash — T-Dongle-S3 has 16MB flash
CONFIG_ESPTOOLPY_FLASHSIZE_16MB=y

# USB — TinyUSB device mode
CONFIG_TINYUSB=y
CONFIG_TINYUSB_VENDOR_COUNT=1
CONFIG_USB_OTG_SUPPORTED=y

# WiFi
CONFIG_ESP_WIFI_STATIC_RX_BUFFER_NUM=16
CONFIG_ESP_WIFI_DYNAMIC_RX_BUFFER_NUM=64
CONFIG_ESP_WIFI_DYNAMIC_TX_BUFFER_NUM=64
CONFIG_ESP_WIFI_AMPDU_TX_ENABLED=y
CONFIG_ESP_WIFI_AMPDU_RX_ENABLED=y
CONFIG_ESP_WIFI_NVS_ENABLED=y

# TCP/IP
CONFIG_LWIP_TCP_SND_BUF_DEFAULT=32768
CONFIG_LWIP_TCP_WND_DEFAULT=32768
CONFIG_LWIP_TCP_RECVMBOX_SIZE=64
CONFIG_LWIP_UDP_RECVMBOX_SIZE=64
CONFIG_LWIP_TCPIP_RECVMBOX_SIZE=64
CONFIG_LWIP_TCP_MSS=1460

# Bluetooth (NimBLE for BLE control channel)
CONFIG_BT_ENABLED=y
CONFIG_BT_NIMBLE_ENABLED=y
CONFIG_BT_NIMBLE_MAX_CONNECTIONS=1

# FreeRTOS
CONFIG_FREERTOS_HZ=1000
CONFIG_FREERTOS_UNICORE=n

# Logging
CONFIG_LOG_DEFAULT_LEVEL_INFO=y

# Partitions — custom OTA (3MB per slot, 16MB flash)
CONFIG_PARTITION_TABLE_CUSTOM=y
CONFIG_PARTITION_TABLE_CUSTOM_FILENAME="partitions.csv"

# Watchdog
CONFIG_ESP_TASK_WDT_TIMEOUT_S=10
```
